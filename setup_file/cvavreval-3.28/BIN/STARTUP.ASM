;CodeVisionAVR C Compiler
;(C) 1998-2013 Pavel Haiduc, HP InfoTech s.r.l.

;EXAMPLE STARTUP FILE FOR CodeVisionAVR V3.05 OR LATER

	.EQU __CLEAR_START=__SRAM_START ;START ADDRESS OF SRAM AREA TO CLEAR
	.EQU __CLEAR_SIZE=__SRAM_END-__SRAM_START+1 ;SIZE OF SRAM AREA TO CLEAR IN BYTES

	CLI		;DISABLE INTERRUPTS
	CLR  R30
	OUT  EECR,R30	;DISABLE EEPROM ACCESS

;DISABLE THE WATCHDOG
	LDI  R31,0x18
	OUT  WDTCR,R31
	OUT  WDTCR,R30

	OUT  MCUCR,R30	;MCUCR=0, NO EXTERNAL SRAM ACCESS

;CLEAR R2-R14
	LDI  R24,13
	LDI  R26,2
	CLR  R27
__CLEAR_REG:
	ST   X+,R30
	DEC  R24
	BRNE __CLEAR_REG

;CLEAR SRAM
	LDI  R24,LOW(__CLEAR_SIZE)
	LDI  R25,HIGH(__CLEAR_SIZE)
	LDI  R26,LOW(__CLEAR_START)
	LDI  R27,HIGH(__CLEAR_START)
__CLEAR_SRAM:
	ST   X+,R30
	SBIW R24,1
	BRNE __CLEAR_SRAM

; __GLOBAL_INI_TBL_PRESENT is predefined by the compiler
; if global variables are initialized during declaration
#ifdef __GLOBAL_INI_TBL_PRESENT

;GLOBAL VARIABLES INITIALIZATION
	LDI  R30,LOW(__GLOBAL_INI_TBL*2)
	LDI  R31,HIGH(__GLOBAL_INI_TBL*2)
__GLOBAL_INI_NEXT:
	LPM
	ADIW R30,1
	MOV  R24,R0
	LPM
	ADIW R30,1
	MOV  R25,R0
	SBIW R24,0
	BREQ __GLOBAL_INI_END
	LPM
	ADIW R30,1
	MOV  R26,R0
	LPM
	ADIW R30,1
	MOV  R27,R0
	LPM
	ADIW R30,1
	MOV  R1,R0
	LPM
	ADIW R30,1
	MOV  R22,R30
	MOV  R23,R31
	MOV  R31,R0
	MOV  R30,R1
__GLOBAL_INI_LOOP:
	LPM
	ADIW R30,1
	ST   X+,R0
	SBIW R24,1
	BRNE __GLOBAL_INI_LOOP
	MOV  R30,R22
	MOV  R31,R23
	RJMP __GLOBAL_INI_NEXT
__GLOBAL_INI_END:

#endif



